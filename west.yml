## west.yml
```yaml
manifest:
  defaults:
    revision: main

  remotes:
    - name: zephyrproject-rtos
      url-base: https://github.com/zephyrproject-rtos

  defaults:
    remote: zephyrproject-rtos
    revision: main

  projects:

    - name: zephyr
      remote: zephyrproject-rtos
      repo-path: zephyr
      revision: main
      import:
        name-allowlist:
          - mbedtls
          - zcbor
          - hal_nxp
          - cmsis
    
      
  self:
    path: my_zephyr_application
```
